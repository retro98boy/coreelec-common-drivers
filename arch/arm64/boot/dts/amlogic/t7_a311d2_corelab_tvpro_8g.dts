#include "t7_a311d2_an400_drm_hdmitx_only_debian.dts"
#include "coreelec_t7_common.dtsi"
#include "a311d2_corelab_tvpro_base.dtsi"

/ {
	model = "CoreLab TVPro";
	coreelec-dt-id = "t7_a311d2_corelab_tvpro_8g";
	amlogic-dt-id = "t7_a311d2_an400-8g";

	memory@00000000 {
		device_type = "memory";
		linux,usable-memory = <0x00000000 0x00000000 0x00000000 0xe0000000
													0x00000001 0x00000000 0x00000001 0x20000000>;
	};
};
